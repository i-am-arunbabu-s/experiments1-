## u-boot/board/ti/3part/Kconfig
```kconfig
if TARGET_AM335X_3PART

config SYS_BOARD
	default "3part"

config SYS_VENDOR
	default "ti"

config SYS_SOC
	default "am33xx"

config SYS_CONFIG_NAME
	default "am335x_3part"

source "board/ti/common/Kconfig"
endif
```

## u-boot/drivers/lcd/Kconfig
```kconfig
menu "LCD Support"

config LCD_TCM
	bool "Enable LCD support"
	depends on DM
	help
	  am335x_3part boards have LCDs which can be used to show the boot screen logo.
	  Use of the device tree for configuration is encouraged.

endmenu
```
